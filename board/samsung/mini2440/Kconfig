## board/samsung/mini2440/Kconfig
```kconfig
if TARGET_MINI2440

config SYS_BOARD
	default "mini2440"

config SYS_VENDOR
	default "samsung"

config SYS_SOC
	default "s3c24x0"

config SYS_CONFIG_NAME
	default "mini2440"

config DRIVER_DM9000
       bool
	default y

config DM9000_BASE
	hex
	default 0x20000300

config MINI2440
	bool
	default y

config NAND_S3C2440
	bool 
	default y

config RTC_S3C24X0
	bool
	default y

config S3C2440
	bool
	default y

config S3C24X0
	bool
	default y

config S3C24X0_SERIAL
	bool
	default y

config SERIAL1
	bool
	default y

config SYS_GENERIC_BOARD
	bool
	default y

config SYS_HUSH_PARSER
	bool
	default y

config SYS_S3C2440_NAND_HWECC
	bool
	default y

config USB_OHCI
	bool
	default y

config USB_OHCI_S3C24XX
	bool
	default y

config ZERO_BOOTDELAY_CHECK
	bool
	default y

endif
```

## configs/mini2440_defconfig
```kconfig
CONFIG_ARM=y
#CONFIG_SYS_TEXT_BASE=0x33ef0000
//CONFIG_SYS_TEXT_BASE=0x33F80000
CONFIG_SYS_TEXT_BASE=0x33F00000
CONFIG_TARGET_MINI2440=y
CONFIG_SYS_PROMPT="MINI2440 # "
CONFIG_USB=y
# CONFIG_CMD_SETEXPR is not set
CONFIG_CMD_USB=y
# CONFIG_CMD_SETEXPR is not set
CONFIG_CMD_DHCP=y
CONFIG_CMD_PING=y
CONFIG_CMD_CACHE=y
CONFIG_CMD_EXT2=y
CONFIG_CMD_FAT=y

CONFIG_MTD_RAW_NAND=y
CONFIG_NAND_S3C2440=y
```
